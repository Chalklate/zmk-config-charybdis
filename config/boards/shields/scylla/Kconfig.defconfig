## config/boards/shields/scylla/Kconfig.defconfig
```kconfig
if SHIELD_SCYLLA_RIGHT

config ZMK_KEYBOARD_NAME
    default "Scylla"

config ZMK_SPLIT_BLE_ROLE_CENTRAL
    default y

endif

if SHIELD_SCYLLA_LEFT || SHIELD_SCYLLA_RIGHT

config ZMK_SPLIT
    default y

endif

menuconfig RGB_INDICATOR
    bool "RGB indicator"
    default n

if RGB_INDICATOR

config LED_STRIP
    default y

config ZMK_RGB_UNDERGLOW_EXT_POWER
    bool "RGB underglow toggling also controls external power"
    default y

endif #RGB_INDICATOR
```

## config/west.yml
```yaml
manifest:
  remotes:
    - name: zmkfirmware
      url-base: https://github.com/zmkfirmware
    - name: petejohanson
      url-base: https://github.com/petejohanson
    - name: inorichi
      url-base: https://github.com/inorichi
    - name: urob
      url-base: https://github.com/urob
    - name: badjeff
      url-base: https://github.com/badjeff
  projects:
    - name: zmk
      remote: petejohanson
      revision: feat/pointers-with-input-processors
      import: app/west.yml
    - name: zmk-pmw3610-driver
      remote: inorichi
      revision: main
    - name: zmk-helpers
      remote: urob
      revision: main
    - name: zmk-split-peripheral-input-relay
      remote: badjeff
      revision: main
  self:
    path: config
```
